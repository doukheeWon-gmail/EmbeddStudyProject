## Kconfig
```kconfig
###############################################################################
# SPDX-License-Identifier: GPL-3.0-or-later
###############################################################################

mainmenu "MANGO-Board M3 Configuration"

menu "Select Board"
    source "board/Kconfig"
endmenu

menu "Select Driver"
    source "driver/Kconfig"
endmenu

menu "Select module"
    source "module/Kconfig"
endmenu

menu "Select OS"
    source "kernel/Kconfig"
endmenu

menu "Select Sample Chapter"
    source "SampleChapter/Kconfig"
endmenu

config CUSTOM
    string "Custom project name"
    default ""

###############################################################################
```

## SampleChapter/Kconfig
```kconfig
###############################################################################
# SPDX-License-Identifier: GPL-3.0-or-later
###############################################################################



menu "Select Simple Sample Chapter"
    source "SampleChapter/StudyCode/Kconfig"
endmenu


menu "Select Simple Free RTOS Chapter"
    depends on FREE_RTOS
    source "SampleChapter/FreeRTOS_StudyCode/Kconfig"
endmenu

###############################################################################
```

## SampleChapter/StudyCode/Hal_EX/Kconfig
```kconfig
###############################################################################
# SPDX-License-Identifier: GPL-3.0-or-later
###############################################################################

menu "stm32F103 Board Hal Library Sample"
    source "SampleChapter/StudyCode/Hal_EX/stm32F103/Kconfig"
endmenu

menu "stm32F4 Board Hal Library Sample"
    source "SampleChapter/StudyCode/Hal_EX/stm32F4/Kconfig"
endmenu

###############################################################################
```

## SampleChapter/StudyCode/Hal_EX/stm32F103/Kconfig
```kconfig
###############################################################################
# SPDX-License-Identifier: GPL-3.0-or-later
###############################################################################

config HAL_EMPTY
    bool "HAL EMpty Source Template"
    default n
    select HAL_DRIVER


###############################################################################
```

## SampleChapter/StudyCode/Hal_EX/stm32F4/Kconfig
```kconfig
###############################################################################
# SPDX-License-Identifier: GPL-3.0-or-later
###############################################################################

config HAL_EMPTY_M4
    bool "HAL EMpty Source Template"
    default n
    select HAL_DRIVER_M4


###############################################################################
```

## SampleChapter/StudyCode/Kconfig
```kconfig
###############################################################################
# SPDX-License-Identifier: GPL-3.0-or-later
###############################################################################


menu "Select Sample Chapter Mango Story v2.0"
    source "SampleChapter/StudyCode/MStory2.0/Kconfig"
endmenu

menu "Select Sample Chapter Mango Story v3.0"
    source "SampleChapter/StudyCode/MStory3.0/Kconfig"
endmenu

menu "Select Sample Chapter Mango-M32F4 Board"
    source "SampleChapter/StudyCode/MANGOSTM32F4/Kconfig"
endmenu


###############################################################################
```

## SampleChapter/StudyCode/MANGOSTM32F4/Kconfig
```kconfig
###############################################################################
# SPDX-License-Identifier: GPL-3.0-or-later
###############################################################################

config PRINTF_TEST_M4
    bool "printf Mango-M4 Board Test"
    select MANGO_M4
    select STANDARD_DRIVER_M4
    default n
config LED_TEST_M4
    bool "led testing Mango-M4 Board Test"
    select MANGO_M4
    select STANDARD_DRIVER_M4
    default n

config KEY_TEST_M4
    bool "Key testing Mango-M4 Board Test"
    select MANGO_M4
    select STANDARD_DRIVER_M4
    default n

config KEY_EXTI_TEST_M4
    bool "Key Interrupt Mango-M4 Board Test"
    select MANGO_M4
    select STANDARD_DRIVER_M4
    default n

###############################################################################
```

## SampleChapter/StudyCode/MStory2.0/Kconfig
```kconfig
###############################################################################
# SPDX-License-Identifier: GPL-3.0-or-later
###############################################################################

config MSTORY_V2_0_SRC_LED_1
    bool "MStory Version 2.0 Chapter LED ON OFF First Test "
    default n

config MSTORY_V2_0_SRC_LED_2
    bool "MStory Version 2.0 Chapter LED ON OFF GPIO RESET SET Use"
    default n

config MSTORY_V2_0_SRC_LED_3
    bool "MStory Version 2.0 Chapter LED OFF GPIO SET Use"
    default n

config MSTORY_V2_0_SRC_LED_4
    bool "MStory Version 2.0 Chapter LED ON OFF ALL SET RESET Use"
    default n

config MSTORY_V2_0_SRC_LED_5
    bool "MStory Version 2.0 Chapter LED ON OFF ALL Chnage coding style"
    default n

config MSTORY_V2_0_SRC_LED_6
    bool "MStory Version 2.0 Chapter LED ON OFF ALL Change coding style version 2"
    default n

config MSTORY_V2_0_SRC_KEY_PRESS
    bool "MStory Version 2.0 Chapter KEY PRESS "
    default n

config MSTORY_V2_0_SRC_HELLO_WORLD
    bool "MStory Version 2.0 Chapter Hello World 1"
    default n

config MSTORY_V2_0_SRC_HELLO_WORLD_TWO
    bool "MStory Version 2.0 Chapter Hello World 2"
    default n

config MSTORY_V2_0_SRC_GETCHAR
    bool "MStory Version 2.0 Chapter Get Char "
    default n

###############################################################################
```

## SampleChapter/StudyCode/MStory2.0/MANGO-Z1/Kconfig
```kconfig
###############################################################################
# SPDX-License-Identifier: GPL-3.0-or-later
###############################################################################


config CMSIS_SAMPLE_HELLO_WORLD_Z1
    bool "CMSIS Standard driver Start Sample Z1"
    default n
    select STANDARD_DRIVER

config CMSIS_LED_KEY_CONTROL
    bool "CMSIS Standard Driver LED KEY Control Z1"
    default n
    select STANDARD_DRIVER
    
config CMSIS_CLOCK_CONTROL
    bool "CMSIS Standard Driver Clock Control Z1"
    default n
    select STANDARD_DRIVER

config CMSIS_KEY_INTERRUPT
    bool "CMSIS Standard Driver key interrupt push button Z1"
    default n
    select STANDARD_DRIVER

###############################################################################
```

## SampleChapter/StudyCode/MStory3.0/Kconfig
```kconfig
###############################################################################
# SPDX-License-Identifier: GPL-3.0-or-later
###############################################################################

config MSTORY_V3_0_SRC_LIB_DEBUG
    bool "MStory Version 3.0 Chapter Lib DEBUG"
    select STANDARD_DRIVER
    select CC2520
    select MANGO_Z1
    default n

config MSTORY_V3_0_SRC_BIT_BAND
    bool "MStory Version 3.0 Chapter Bit_Band"
    select STANDARD_DRIVER
    select CC2520
    select MANGO_Z1
    select USB_HID
    default n

###############################################################################
```

## board/Kconfig
```kconfig
###############################################################################
# SPDX-License-Identifier: GPL-3.0-or-later
###############################################################################


config MANGO_M3
    bool "Select Board Mango-M3 Board"
    default n

config MANGO_Z1
    bool "Select Board Mango-Z1 Board"
    default n

config NUCLEO
    bool "Select Board Nucleo M3 Board"
    default n

config MANGO_M4
    bool "Select Board Mango-M4 Board"
    default n

###############################################################################
```

## driver/Kconfig
```kconfig
###############################################################################
# SPDX-License-Identifier: GPL-3.0-or-later
###############################################################################

config STANDARD_DRIVER
    bool "Standard Driver Select Core M3"
    default n

config HAL_DRIVER
    bool "Hal Driver Select Core M3"
    default n

config STANDARD_DRIVER_M4
    bool "Standard Driver Select Core M4"
    default n

config HAL_DRIVER_M4
    bool "Hal Driver Select Core M4"
    default n

###############################################################################
```

## module/Kconfig
```kconfig
###############################################################################
# SPDX-License-Identifier: GPL-3.0-or-later
###############################################################################


config CC2520
    bool "cc2520 zigbee select"
    default n

config USB_HID
    bool "USB.HID Select"
    default n

config FAT_FS
    bool "FAT FS library Select"
    default n

config LWIP_V2_12
    bool "LwIP library Select"
    default n

###############################################################################
```
